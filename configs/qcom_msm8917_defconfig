## configs/qcom_msm8917_defconfig
```kconfig
#include "qcom_defconfig"

CONFIG_DEBUG_UART=y
CONFIG_DEBUG_UART_ANNOUNCE=y
CONFIG_DEBUG_UART_BASE=0x78b0000
CONFIG_DEBUG_UART_MSM=y
CONFIG_DEBUG_UART_CLOCK=7372800

CONFIG_CI_UDC=y
CONFIG_PHY_QCOM_USB_HS_28NM=y
CONFIG_USB_EHCI_HCD=y
CONFIG_USB_EHCI_MSM=y
# CONFIG_CI_UDC requires CONFIG_DM_USB_GADGET disabled
CONFIG_DM_USB_GADGET=n
# CONFIG_CI_UDC conflicts with DWC3 drivers
CONFIG_USB_DWC3=n
CONFIG_USB_XHCI_DWC3=n
```

## configs/xiaomi_riva_defconfig
```kconfig
#include "qcom_msm8917_defconfig"
#include <board/qualcomm/qcom-phone.config>

CONFIG_DEFAULT_DEVICE_TREE="qcom/msm8917-xiaomi-riva"
```
